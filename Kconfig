## Kconfig
```kconfig
config SN9C20X
	tristate "sn9c20x based webcams"
	depends on VIDEO_V4L2 && (VIDEO_V4L1 || VIDEO_V4L1_COMPAT)
	---help---
	  Say Y or M here if you want to use a sn9c20x webcam.

	  To compile this driver as a module, choose M here: the
	  module will be called "sn9c20x.ko".


config SN9C20X_DEBUGFS
	bool "enable debugfs for sn9c20x webcams"
	depends on SN9C20X
	---help---
	  Say Y here in order to enable debugfs for sn9c20x webcams

config SN9C20X_EVDEV
	bool "enable evdev for sn9c20x webcams"
	depends on SN9C20X
	---help---
	  Say Y here in order to evdev support for webcam button presses
```
